#include "dino.h"
#include "oled.h"
#include "key.h"
#include <stdlib.h>
#include "gpio.h"
#include <math.h>

#define pi 3.1415926535

/* ---------------- 图像数据区域 ---------------- */

const uint8_t Ground[]={
    0x0C,0x0C,0x0C,0x0E,0x0E,0x0C,0x0C,0x0C,0x0C,0x0C,0x0C,0x4C,0x6C,0x2C,0x0C,0x0C,
    0x0C,0x0C,0x0C,0x0C,0x0C,0x0E,0x0C,0x0C,0x0E,0x0F,0x3E,0x2E,0x2C,0x0C,0x0C,0x0C,
    0x0C,0x0C,0x0C,0x0C,0x0C,0x0C,0x2C,0x2C,0x2C,0x0C,0x0C,0x0C,0x0C,0x0E,0x0E,0x0E,
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    0x0E,0x0E,0x0C,0x0C,0x0C,0x0C,0x0C,0x0C,0x0C,0x4D,0x4F,0x4E,0x0E,0x0C,0x9C,0x0C,
};

const uint8_t Barrier[][48]={
    //Barrier0 (三连仙人掌)
    0x00,0x00,0x00,0x00,0x00,0x00,0xF8,0xFC,0xF8,0x00,0x00,0xF0,0xF0,0x00,0x00,0x00,
    0xC0,0xC0,0xC7,0xCF,0xCC,0x0C,0xFF,0xFF,0xFF,0x03,0xC3,0xC3,0xC1,0xC0,0xC0,0xC0,
    0x00,0x00,0x00,0x00,0x00,0x00,0x01,0x01,0x01,0x00,0x00,0x00,0x00,0x00,0x00,0x00,
    //Barrier1 (大仙人掌)
    0x00,0x00,0x00,0x80,0xC0,0x00,0x00,0x00,0x78,0xE0,0xC0,0xFC,0xFC,0x00,0x00,0x00,
    0xC0,0xDC,0x18,0xFF,0xFF,0x06,0x03,0x00,0x00,0x00,0x01,0xFF,0xFF,0x0C,0xCE,0xC6,
    0x00,0x00,0x00,0x01,0x01,0x00,0x00,0x00,0x00,0x00,0x00,0x01,0x01,0x00,0x00,0x00,
    //Barrier2 (小仙人掌)
    0x00,0x00,0x00,0x00,0x00,0xC0,0x00,0xFC,0xF0,0xC0,0x60,0x00,0x00,0x00,0x00,0x00,
    0xC0,0x08,0xFC,0xFE,0x30,0x18,0x01,0xFF,0xFF,0x01,0x00,0x18,0x70,0xFE,0x07,0xC0,
    0x00,0x00,0x01,0x01,0x00,0x00,0x00,0x01,0x01,0x00,0x00,0x00,0x00,0x01,0x00,0x00,
};

const uint8_t Cloud[]={
    0x00,0x70,0x58,0x58,0x4C,0x46,0x43,0x41,0x43,0x42,0x46,0x44,0x4C,0x58,0x70,0x00,
};

/* 
 * 恐龙图像数据优化
 * 删除了中间行首尾的 0xC0/0xC 部分，去除了恐龙奔跑时的白色方框。
 * 现在的数组只包含恐龙本身的像素，不会绘制多余的白线。
 */
const uint8_t Dino[][48]={
    // 动作0：奔跑 (后腿着地)
    0x00,0x80,0x80,0x00,0x00,0x00,0x00,0xF8,0xFC,0xFC,0xFC,0x74,0x7C,0x78,0x70,0x00,
    0x00,0x03,0x0F,0xFE,0xFE,0x3E,0x3F,0x7F,0x7F,0x5F,0x06,0x02,0x03,0x00,0x00,0x00,
    0x00,0x00,0x00,0x01,0x01,0x01,0x00,0x00,0x00,0x00,0x00,0x00,0x00,0x00,0x00,0x00,
    
    // 动作1：奔跑 (前腿着地)
    0x00,0x80,0x80,0x00,0x00,0x00,0x00,0xF8,0xFC,0xFC,0xFC,0x74,0x7C,0x78,0x70,0x00,
    0x00,0x03,0x0F,0x7E,0x7E,0x5E,0x1F,0xFF,0xFF,0x1F,0x06,0x02,0x03,0x00,0x00,0x00,
    0x00,0x00,0x00,0x00,0x00,0x00,0x00,0x01,0x01,0x01,0x00,0x00,0x00,0x00,0x00,0x00,
    
    // 动作2：跳跃 (双腿弯曲)
    0x00,0x80,0x80,0x00,0x00,0x00,0x00,0xF8,0xFC,0xFC,0xFC,0x74,0x7C,0x78,0x70,0x00,
    0x00,0x03,0x0F,0xFE,0xFE,0x1E,0x1F,0xFF,0xFF,0x1F,0x06,0x02,0x03,0x00,0x00,0x00,
    0x00,0x00,0x00,0x01,0x01,0x01,0x00,0x01,0x01,0x01,0x00,0x00,0x00,0x00,0x00,0x00,
};

/*===========全局变量=============*/
// 定义物体碰撞箱结构体 (AABB检测)
// struct Object_Position{
//     uint8_t minX;
//     uint8_t minY;
//     uint8_t maxX;
//     uint8_t maxY;
// };

uint16_t Ground_Pos; // 地面移动偏移量
int Score;           // 游戏分数

uint8_t barrier_flag;          // 当前障碍物类型索引
uint8_t Barrier_Pos;           // 障碍物X轴位置偏移量
struct Object_Position barrier; // 障碍物的碰撞箱

uint8_t Cloud_Pos; // 云朵位置偏移

uint8_t dino_jump_flag=0; // 0:奔跑状态，1:跳跃状态
extern uint8_t IsKey;    // 按键键值 (外部引用)
uint16_t jump_t;          // 跳跃时间计数器 (用于计算正弦波高度)
uint8_t Jump_Pos;         // 当前跳跃高度偏移
struct Object_Position dino; // 恐龙的碰撞箱

/*===========游戏函数=============*/
// 显示分数
void Show_Score(void)
{
    OLED_ShowNum(1, 17, Score, 5, 6);
}

// 绘制滚动地面
void Show_Ground(void)
{
    if(Ground_Pos<128)
    {
        for(uint8_t i=0;i<128;i++)
        {
            OLED_Buffer[7][i]=Ground[i+Ground_Pos];
        }
    }
    else
    {
        for(uint8_t i=0;i<255-Ground_Pos;i++)
        {
            OLED_Buffer[7][i]=Ground[i+Ground_Pos];
        }
        for(uint8_t i=255-Ground_Pos;i<128;i++)
        {
            OLED_Buffer[7][i]=Ground[i-(255-Ground_Pos)];
        }
    }
}

// 绘制障碍物
void Show_Barrier(void)
{
    if(Barrier_Pos >= 143)
    {
        barrier_flag = rand()%3;
    }
    OLED_ShowImage_Reverse(127-Barrier_Pos, 44, 16, 18, Barrier[barrier_flag], 1);

    barrier.minX = (127 - Barrier_Pos) + 5;
    barrier.minY = 44 + 4;
    barrier.maxX = (127 - Barrier_Pos) +11;
    barrier.maxY = 62;
}

// 绘制云朵
void Show_Cloud(void)
{
    OLED_ShowImage(127-Cloud_Pos, 9, 16, 8, Cloud);
}

// 绘制恐龙
void Show_Dino(void)
{
    IsKey=Key_GetNum();
    if(IsKey == 1 && dino_jump_flag == 0)
    {
        dino_jump_flag = 1;
    }

    if (dino_jump_flag) 
    {
        Jump_Pos = 28 * sin((float)(pi * jump_t / 1000));
    } 
    else 
    {
        Jump_Pos = 0;
    }

    // 恐龙的基础Y坐标设置为42
    // 图像高18，42+18=60。地面在Y=56~63，所以恐龙脚部略微踩入地面，视觉上更稳。
    uint8_t dino_base_y = 42; 
    uint8_t current_dino_y = dino_base_y - Jump_Pos;

    // 根据状态绘制不同的恐龙图像
    if(dino_jump_flag==0)
    {
        // 奔跑动画：根据地面移动距离切换两张图片(左右脚交替)
        if((Ground_Pos / 8) % 2 == 0) 
            OLED_ShowImage(0, current_dino_y, 16, 18, Dino[0]);
        else 
            OLED_ShowImage(0, current_dino_y, 16, 18, Dino[1]);
    }
    else
    {
        // 跳跃时的静态图片
        OLED_ShowImage(0, current_dino_y, 16, 18, Dino[2]);
    }
    
    // 更新恐龙的碰撞箱
    // X固定在0，宽度16。为了防误触，X范围缩进到 4~12
    dino.minX = 0 + 4;
    dino.maxX = 16 - 4;
    dino.minY = current_dino_y + 2;
    dino.maxY = current_dino_y + 18 - 2;
}

// 碰撞检测逻辑 (AABB算法)
// 返回值: 1=碰撞, 0=安全
int IsColliding(struct Object_Position *a, struct Object_Position *b)
{
    // 如果两个矩形区域有重叠，则发生碰撞
    if( (a->maxX > b->minX) && 
        (a->minX < b->maxX) && 
        (a->maxY > b->minY) && 
        (a->minY < b->maxY) )
    {
        // 碰撞发生，显示 Game Over
        OLED_Clear();
        OLED_ShowString(2, 4, "GAME  OVER", 8); 
        OLED_Update();
        
        // 停顿1.5秒让玩家看到结果
        HAL_Delay(1500); 
        
        // 清屏准备重新开始
        OLED_Clear();
        OLED_Update();
        return 1;
    }
    return 0;
}


// 游戏主循环
int DinoGame_Animation(void)
{
    while(1)
    {
        int res_flag=0;
        OLED_Clear();

        Show_Ground();
        Show_Cloud();
        Show_Barrier();
        Show_Dino();
        Show_Score();
        OLED_Update();

        res_flag=IsColliding(&dino, &barrier);
        if(res_flag==1)
            return 0;
    }
}

// 游戏逻辑定时器中断调用函数 (通常在1ms定时器中调用)
void Dino_Tick(void)
{
    static uint8_t Score_Count, Ground_Count, Cloud_Count;

    Score_Count++;
    Ground_Count++;
    Cloud_Count++;

    if(Score_Count >= 100)
    {
        Score_Count = 0;
        Score++;
    }

    // 地面和障碍物移动逻辑
    if(Ground_Count >= 20) 
    {
        Ground_Count = 0;
        Ground_Pos++;
        Barrier_Pos++;
        
        if(Ground_Pos >= 256) Ground_Pos = 0;
        if(Barrier_Pos >= 144) Barrier_Pos = 0;
    }

    if(Cloud_Count >= 50)
    {
        Cloud_Count = 0;
        Cloud_Pos++;
        if(Cloud_Pos >= 200) Cloud_Pos = 0;
    }

    if(dino_jump_flag == 1)
    {
        jump_t++;
        if(jump_t >= 1000)
        {
            jump_t = 0;
            dino_jump_flag = 0;
        }
    }
}

// 游戏数据初始化
void DinoGame_Pos_Init(void)
{
    Score = 0;
    Ground_Pos = 0;
    Barrier_Pos = 0;
    Cloud_Pos = 0;
    Jump_Pos = 0;
    dino_jump_flag = 0;
    jump_t = 0;
    // 初始让障碍物归零，避免一开局就生成在脸上
    Barrier_Pos = 0; 
    barrier_flag = 0;
}

